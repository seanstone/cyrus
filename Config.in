## Config.in
```kconfig
source "../package/raspberrypi-omxcam/Config.in"
source "../package/libcbor/Config.in"
```

## configs/rpi0/defconfig
```kconfig
BR2_arm=y
BR2_arm1176jzf_s=y
BR2_SVN="svn"
BR2_DL_DIR="$(BR2_EXTERNAL)/build/dl"
BR2_CCACHE=y
BR2_CCACHE_DIR="$(BR2_EXTERNAL)/build/ccache"
BR2_TOOLCHAIN_BUILDROOT_GLIBC=y
BR2_PACKAGE_HOST_LINUX_HEADERS_CUSTOM_4_14=y
BR2_BINUTILS_VERSION_2_31_X=y
BR2_GCC_VERSION_8_X=y
BR2_TOOLCHAIN_BUILDROOT_CXX=y
BR2_GCC_ENABLE_LTO=y
BR2_ROOTFS_MERGED_USR=y
BR2_TARGET_GENERIC_HOSTNAME="rpi0"
BR2_TARGET_GENERIC_ROOT_PASSWD="1817"
BR2_TARGET_TZ_INFO=y
BR2_TARGET_LOCALTIME="ROC"
BR2_ROOTFS_OVERLAY="$(BR2_EXTERNAL)/configs/rpi0/rootfs"
BR2_ROOTFS_POST_BUILD_SCRIPT="board/raspberrypi0/post-build.sh"
BR2_ROOTFS_POST_IMAGE_SCRIPT="$(BR2_EXTERNAL)/configs/rpi0/post-image.sh"
BR2_LINUX_KERNEL=y
BR2_LINUX_KERNEL_CUSTOM_GIT=y
BR2_LINUX_KERNEL_CUSTOM_REPO_URL="https://github.com/raspberrypi/linux.git"
BR2_LINUX_KERNEL_CUSTOM_REPO_VERSION="raspberrypi-kernel_1.20181112-1"
BR2_LINUX_KERNEL_PATCH="$(BR2_EXTERNAL)/configs/rpi0/patches"
BR2_LINUX_KERNEL_USE_CUSTOM_CONFIG=y
BR2_LINUX_KERNEL_CUSTOM_CONFIG_FILE="$(BR2_EXTERNAL)/configs/rpi0/linux.config"
BR2_LINUX_KERNEL_DTS_SUPPORT=y
BR2_LINUX_KERNEL_INTREE_DTS_NAME="bcm2708-rpi-b-plus bcm2708-rpi-0-w"
BR2_LINUX_KERNEL_EXT_XENOMAI=y
BR2_LINUX_KERNEL_EXT_XENOMAI_ADEOS_PATCH="$(BR2_EXTERNAL)/configs/rpi0/ipipe-core-4.14.81-arm-5.patch"
BR2_PACKAGE_BUSYBOX_CONFIG="$(BR2_EXTERNAL)/configs/rpi0/busybox.config"
BR2_PACKAGE_BUSYBOX_SHOW_OTHERS=y
BR2_PACKAGE_RPI_FIRMWARE=y
BR2_PACKAGE_RPI_FIRMWARE_X=y
BR2_PACKAGE_RPI_FIRMWARE_INSTALL_VCDBG=y
BR2_PACKAGE_RPI_WIFI_FIRMWARE=y
BR2_PACKAGE_OPENSSL=y
BR2_PACKAGE_BCM2835=y
BR2_PACKAGE_WIRINGPI=y
BR2_PACKAGE_LIBPTHREAD_STUBS=y
BR2_PACKAGE_AVAHI=y
BR2_PACKAGE_AVAHI_DAEMON=y
BR2_PACKAGE_DROPBEAR=y
# BR2_PACKAGE_DROPBEAR_CLIENT is not set
BR2_PACKAGE_DROPBEAR_DISABLE_REVERSEDNS=y
BR2_PACKAGE_IPROUTE2=y
BR2_PACKAGE_IPTABLES=y
BR2_PACKAGE_IW=y
BR2_PACKAGE_PTPD2=y
BR2_PACKAGE_RPCBIND=y
BR2_PACKAGE_RSYNC=y
BR2_PACKAGE_WIRELESS_TOOLS=y
BR2_PACKAGE_WPA_SUPPLICANT=y
BR2_PACKAGE_WPA_SUPPLICANT_AP_SUPPORT=y
BR2_PACKAGE_WPA_SUPPLICANT_WIFI_DISPLAY=y
BR2_PACKAGE_WPA_SUPPLICANT_AUTOSCAN=y
BR2_PACKAGE_WPA_SUPPLICANT_EAP=y
BR2_PACKAGE_WPA_SUPPLICANT_CLI=y
BR2_PACKAGE_WPA_SUPPLICANT_WPA_CLIENT_SO=y
BR2_PACKAGE_WPA_SUPPLICANT_PASSPHRASE=y
BR2_PACKAGE_XENOMAI_VERSION="3.0.7"
BR2_PACKAGE_HTOP=y
BR2_PACKAGE_KMOD=y
BR2_PACKAGE_KMOD_TOOLS=y
BR2_PACKAGE_NANO=y
BR2_TARGET_ROOTFS_EXT2=y
BR2_TARGET_ROOTFS_EXT2_4=y
BR2_TARGET_ROOTFS_EXT2_SIZE="30M"
# BR2_TARGET_ROOTFS_TAR is not set
BR2_PACKAGE_HOST_DOSFSTOOLS=y
BR2_PACKAGE_HOST_GENIMAGE=y
BR2_PACKAGE_HOST_MTOOLS=y
BR2_PACKAGE_RASPBERRYPI_OMXCAM=y
```

## package/libcbor/Config.in
```kconfig
config BR2_PACKAGE_LIBCBOR
        bool "libcbor"
        help
          libcbor is a C library for parsing and generating CBOR, the general-purpose schema-less binary data format.

          https://github.com/PJK/libcbor
```

## package/python-picamera/Config.in
```kconfig
config BR2_PACKAGE_PYTHON_PICAMERA
        bool "python-picamera"
        depends on BR2_PACKAGE_PYTHON3
```

## package/raspberrypi-omxcam/Config.in
```kconfig
config BR2_PACKAGE_RASPBERRYPI_OMXCAM
        bool "raspberrypi-omxcam"
        help
          OpenMAX camera abstraction layer for the Raspberry Pi

          https://github.com/christianrauch/raspberrypi-omxcam
```
